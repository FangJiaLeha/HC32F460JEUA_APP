## bsp/Kconfig
```kconfig
menu "Pudu BSP Config"

source "$BSP_DIR/drivers/Kconfig"
source "$BSP_DIR/pallet_check_board/Kconfig"
source "$BSP_DIR/pcf8574/Kconfig"
source "$BSP_DIR/tlc59108/Kconfig"
source "$BSP_DIR/vl53l0x_dev_lib/Kconfig"
source "$BSP_DIR/ws2812/Kconfig"

endmenu
```

## bsp/drivers/Kconfig
```kconfig
menu "Device Drivers"

config RT_USING_ONEWIRE
    bool "Using one-wire device drivers"
    default n

endmenu
```

## bsp/pallet_check_board/Kconfig
```kconfig
menu "BSP Pallet Check"

config BSP_USING_PALLET_LED_BAR
    bool "Using PALLET LED BAR"
    default n
    if BSP_USING_PALLET_LED_BAR
        config BSP_PALLET_LED_BAR_PWMX
            string "Set PALLET LED BAR pwm interface"
            default pwm0

        config BSP_PALLET_LED_BAR_CHANNEL
            int "Set PALLET LED BAR pwm channel"
            default 0

        config BSP_PALLET_LED_BAR_DEV
            string "Set PALLET LED BAR device name"
            default PLedBar
    endif

config BSP_USING_HEARTBEAT_LED
    bool "Using HEARTBEAT LED"
    default n
    if BSP_USING_HEARTBEAT_LED
        config BSP_HEARTBEAT_PIN
            int "Set HEARTBEAT LED pin number"
            default 0
    endif

endmenu
```

## bsp/pcf8574/Kconfig
```kconfig
menu "PCF8574"

config BSP_USING_I2C_PCF8574
    bool "Using PCF8574"
    select RT_USING_I2C
    default n
    if BSP_USING_I2C_PCF8574
        config BSP_I2C_PCF8574_BUS
            string "Set PCF8574 i2c bus name"
            default i2c0

        config BSP_I2C_PCF8574_DEV
            string "Set PCF8574 device name"
            default pcf8574

        config BSP_I2C_PCF8574_ADDRESS
            int "Set PCF8574 device address"
            default 0x27
    endif

endmenu
```

## bsp/tlc59108/Kconfig
```kconfig
menu "TLC59108"

config BSP_USING_I2C_TLC59108
    bool "Using TLC59108"
    select RT_USING_I2C
    default n
    if BSP_USING_I2C_TLC59108
        config BSP_I2C_TLC59108_BUS
            string "Set TLC59108 i2c bus name"
            default i2c0

        config BSP_I2C_TLC59108_DEV
            string "Set TLC59108 device name"
            default tlc59108

        config BSP_I2C_TLC59108_ADDRESS
            int "Set TLC59108 device address"
            default 0x4F
    endif

endmenu
```

## bsp/vl53l0x_dev_lib/Kconfig
```kconfig
menu "VL53L0X"

config BSP_USING_I2C_VL53L0X
    bool "Using VL53L0X"
    select RT_USING_I2C
    default n
    if BSP_USING_I2C_VL53L0X
        config BSP_I2C_VL53L0X_BUS
            string "Set VL53L0X i2c bus name"
            default i2c0

        config BSP_I2C_VL53L0X_DEV
            string "Set VL53L0X device name"
            default vl53l0x

        config BSP_I2C_VL53L0X_ADDRESS
            int "Set VL53L0X device address"
            default 0x29

        config BSP_I2C_VL53L0X_XSHUT1_PIN
            int "Set VL53L0X xshut1 pin"
            default 21

        config BSP_I2C_VL53L0X_XSHUT2_PIN
            int "Set VL53L0X xshut2 pin"
            default 23

        config BSP_I2C_VL53L0X_XSHUT3_PIN
            int "Set VL53L0X xshut3 pin"
            default 20

        config BSP_I2C_VL53L0X_XSHUT4_PIN
            int "Set VL53L0X xshut4 pin"
            default 22
    endif

endmenu
```

## bsp/ws2812/Kconfig
```kconfig
menu "WS2812"

config BSP_USING_PWM_WS2812
    bool "Using WS2812"
    default n
    if BSP_USING_PWM_WS2812
        config BSP_PWM_WS2812_PWMX
            string "Set WS2812 pwm interface"
            default pwm3

        config BSP_PWM_WS2812_PWM_CHANNEL
            int "Set WS2812 pwm channel"
            default 2

        config BSP_PWM_WS2812_DEV
            string "Set TLC59108 device name"
            default ws2812
    endif

endmenu
```

## pkgs/Kconfig
```kconfig
menu "Pudu C-Packages Config"

source "$CPKGS_DIR/led_ctrl_frame/Kconfig"

endmenu
```

## pkgs/led_ctrl_frame/Kconfig
```kconfig
menu "led ctrl frame"

config BSP_USING_LED_FRAME_MOD
    bool "Using TLC59108"
    select RT_USING_I2C
    default n

endmenu
```

## project/Kconfig
```kconfig
mainmenu "RT-Thread Configuration"

config APP_DIR
    string
    option env="APP_ROOT"
    default "../src"

config SOC_DIR
    string
    option env="SOC_ROOT"
    default "../soc"

config BSP_DIR
    string
    option env="BSP_ROOT"
    default "../bsp"

config CPKGS_DIR
    string
    option env="CPKGS_ROOT"
    default "../pkgs"

config PKGS_DIR
    string
    option env="PKGS_ROOT"
    default "packages"

config RTT_DIR
    string
    option env="RTT_ROOT"
    default "../rtos"

source "$RTT_DIR/Kconfig"
source "$PKGS_DIR/Kconfig"

menu "Select Chip Type"
    choice
        prompt "Select Chip type"
        default CHIP_SEL_HC32F460JEUA

        config CHIP_SEL_HC32F460PETB
        config CHIP_SEL_HC32F460PCTB
            bool "HC32F460-LQFP100"

        config CHIP_SEL_HC32F460KETA
        config CHIP_SEL_HC32F460KCTA
            bool "HC32F460-LQFP64"

        config CHIP_SEL_HC32F460KEUA
            bool "HC32F460-QFN60TR"

        config CHIP_SEL_HC32F460JETA
        config CHIP_SEL_HC32F460JCTA
        config CHIP_SEL_HC32F460JEUA
            bool "HC32F460-LQFP48/QFN48TR"
    endchoice
endmenu

if CHIP_SEL_HC32F460PETB || \
   CHIP_SEL_HC32F460PCTB || \
   CHIP_SEL_HC32F460KETA || \
   CHIP_SEL_HC32F460KCTA || \
   CHIP_SEL_HC32F460KEUA || \
   CHIP_SEL_HC32F460JETA || \
   CHIP_SEL_HC32F460JCTA || \
   CHIP_SEL_HC32F460JEUA
    source "$SOC_DIR/soc_hc32f460xxxx/drivers/Kconfig"
endif

source "$BSP_DIR/Kconfig"
source "$CPKGS_DIR/Kconfig"
source "$APP_DIR/Kconfig"
```
